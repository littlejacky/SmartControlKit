## build/Kconfig/arch/Kconfig
```kconfig
# Load Zephyr Arch Kconfig descriptions.
osource "/home/maxitai/ncs/v3.1.0/zephyr/arch/rx/Kconfig"
osource "/home/maxitai/ncs/v3.1.0/zephyr/arch/x86/Kconfig"
osource "/home/maxitai/ncs/v3.1.0/zephyr/arch/xtensa/Kconfig"
osource "/home/maxitai/ncs/v3.1.0/zephyr/arch/sparc/Kconfig"
osource "/home/maxitai/ncs/v3.1.0/zephyr/arch/riscv/Kconfig"
osource "/home/maxitai/ncs/v3.1.0/zephyr/arch/posix/Kconfig"
osource "/home/maxitai/ncs/v3.1.0/zephyr/arch/mips/Kconfig"
osource "/home/maxitai/ncs/v3.1.0/zephyr/arch/arm64/Kconfig"
osource "/home/maxitai/ncs/v3.1.0/zephyr/arch/arm/Kconfig"
osource "/home/maxitai/ncs/v3.1.0/zephyr/arch/arc/Kconfig"
```

## build/mvp/Kconfig/boards/Kconfig.nrf54l15dk
```kconfig
# Load board Kconfig descriptions.
osource "/home/maxitai/ncs/v3.1.0/zephyr/boards/nordic/nrf54l15dk/Kconfig.nrf54l15dk"
```
